## application/edge_agent/main/Kconfig.projbuild
```kconfig
menu "App Config"

menu "Default Wi-Fi Settings"

    config APP_WIFI_SSID
        string "Default Wi-Fi SSID"
        default ""
        help
            Default Wi-Fi SSID used to populate app settings.

    config APP_WIFI_PASSWORD
        string "Default Wi-Fi password"
        default ""
        help
            Default Wi-Fi password used to populate app settings.

    config APP_WIFI_AP_SSID_PREFIX
        string "Provisioning AP SSID prefix"
        default "esp-claw"
        help
            Prefix used to build the unique provisioning AP SSID. The full
            SSID is "<prefix>-<MAC[3..5]>" (e.g. esp-claw-84AEE5).

    config APP_WIFI_AP_CHANNEL
        int "Provisioning AP channel"
        range 1 13
        default 1
        help
            Channel used by the provisioning SoftAP.

    config APP_WIFI_AP_MAX_CONN
        int "Provisioning AP max connections"
        range 1 10
        default 4
        help
            Maximum number of concurrent stations on the provisioning AP.

    config APP_WIFI_MAX_RETRY
        int "STA max retries before AP fallback"
        range 1 20
        default 5
        help
            After this many consecutive STA connection failures the device
            falls back to pure AP mode and waits for the user to provision
            new credentials.

endmenu

menu "AT UART1 Provisioning Notify"

    config APP_AT_UART1_NOTIFY_ENABLE
        bool "Enable UART1 provisioning notifications"
        default y
        depends on APP_CLAW_CAP_AT_MQTT
        help
            Send provisioning status lines to the host over UART1 when Wi-Fi
            state changes or when the device starts already connected.

    config APP_AT_UART1_TX_PIN
        int "UART1 AT TX pin"
        default 17
        depends on APP_AT_UART1_NOTIFY_ENABLE

    config APP_AT_UART1_RX_PIN
        int "UART1 AT RX pin"
        default 18
        depends on APP_AT_UART1_NOTIFY_ENABLE

    config APP_AT_UART1_BAUD
        int "UART1 AT baud rate"
        default 115200
        depends on APP_AT_UART1_NOTIFY_ENABLE

endmenu

endmenu
```

## components/lua_modules/lua_module_environmental_sensor/Kconfig
```kconfig
menu "Lua Environmental Sensor Module"

    config LUA_MODULE_ENVIRONMENTAL_SENSOR_ENABLE
        bool "Enable environmental sensor backend"
        default y
        help
            Build the environmental sensor Lua module against the official
            Bosch BME690 component.

endmenu
```

## components/lua_modules/lua_module_fuel_gauge/Kconfig
```kconfig
menu "Lua Fuel Gauge Module"

    choice LUA_MODULE_FUEL_GAUGE_CHIP
        prompt "Fuel gauge chip model"
        default LUA_MODULE_FUEL_GAUGE_CHIP_BQ27220
        help
            Select which fuel-gauge backend this Lua module should build against.

        config LUA_MODULE_FUEL_GAUGE_CHIP_BQ27220
            bool "BQ27220"
            help
                Build the Fuel Gauge Lua module with the TI BQ27220 backend.

        config LUA_MODULE_FUEL_GAUGE_CHIP_MAX17048
            bool "MAX17048"
            help
                Reserved for a future MAX17048 backend. The code path is not
                implemented yet and will raise an error at runtime if selected.

        config LUA_MODULE_FUEL_GAUGE_CHIP_STC3115
            bool "STC3115"
            help
                Reserved for a future STC3115 backend. The code path is not
                implemented yet and will raise an error at runtime if selected.
    endchoice

endmenu
```

## components/lua_modules/lua_module_magnetometer/Kconfig
```kconfig
menu "Lua Magnetometer Module"

    choice LUA_MODULE_MAGNETOMETER_CHIP
        prompt "Magnetometer chip model"
        default LUA_MODULE_MAGNETOMETER_CHIP_BMM350
        help
            Select which magnetometer backend this Lua module should build against.

        config LUA_MODULE_MAGNETOMETER_CHIP_BMM350
            bool "BMM350"
            help
                Build the magnetometer Lua module with the BMM350 backend.

        config LUA_MODULE_MAGNETOMETER_CHIP_BMM150
            bool "BMM150"
            help
                Reserved for a future BMM150 backend. The code path is not
                implemented yet and will fail at compile time if selected.

        config LUA_MODULE_MAGNETOMETER_CHIP_MMC5603NJ
            bool "MMC5603NJ"
            help
                Reserved for a future MMC5603NJ backend. The code path is not
                implemented yet and will fail at compile time if selected.
    endchoice

endmenu
```
